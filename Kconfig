## Kconfig
```kconfig
#
# Copyright (c) 2021 Neela Nurseries
#

menu "STMicro sensor drivers"
rsource "drivers/Kconfig"
# rsource "lib/Kconfig"
endmenu
```

## drivers/Kconfig
```kconfig
#
# Copyright (c) 2021 Neela Nurseries
#

menu "STMicro drivers"
rsource "stmicro/Kconfig"
endmenu
```

## drivers/stmicro/Kconfig
```kconfig
#
# Copyright (c) 2021 Neela Nurseries
#

menu "IIS2DH driver"
rsource "iis2dh/Kconfig"
endmenu
```

## dts/bindings/stmicro,iis2dh.yml
```yaml
#
# Copyright (c) 2021 Neela Nurseries
#

description:  STMicro 3-axis accelerometer

compatible: "stmicro,iis2dh"

include: i2c-device.yaml
```
